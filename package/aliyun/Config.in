## package/modbus/Config.in
```kconfig
config BR2_PACKAGE_MODBUS
	bool "Modbus Simulator"
	help
	This is Modbus Simulator in Linux which supports modbus RTU serial & modbus TCP !
	Modbus RTU serial & modbus TCP Support function code 0x01 ~ 0x06
	Modbus RTU :
		Master mode : mbser_mstr
		Slave mode : mbser_slv
	Modbus TCP :
		Master mode : mbtcp_mstr
		Slave mode : mbtcp_slv
```
